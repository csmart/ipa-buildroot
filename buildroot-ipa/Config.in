## buildroot-ipa/Config.in
```kconfig
# For configuration, see:
# https://buildroot.org/downloads/manual/manual.html#outside-br-custom
#menu "External python modules"
#	source "$BR2_EXTERNAL_IPA_PATH/package/python-appdirs/Config.in"
#	source "$BR2_EXTERNAL_IPA_PATH/package/python-babel/Config.in"
#	source "$BR2_EXTERNAL_IPA_PATH/package/python-pytz/Config.in"
#endmenu

config OPENSTACK_IPA_GIT_URL
	string "Ironic Python Agent Git URL"
	help
	  The URL to Git repository for Ironic Python Agent.
	  Specify this if you want to point to a local repo,
	  rather than upstream.
	default "https://git.openstack.org/openstack/ironic-python-agent"

config OPENSTACK_IPA_RELEASE
	string "Git release of Ironic Python Agent"
	help
	  The Git commit/branch/tag of Ironic Python Agent
	  to use from the repo specified at OPENSTACK_IPA_GIT_URL
	default "master"

config OPENSTACK_REQUIREMENTS_GIT_URL
	string "OpenStack Requirements Git URL"
	help
	  The URL to Git repository for OpenStack Requirements.
	  This is used for the upper-constraints.txt file when
	  compiling PIP packages for Ironic Python Agent.
	  
	  Specify this if you want to point to a local repo,
	  rather than upstream.
	default "https://git.openstack.org/openstack/requirements"

config OPENSTACK_REQUIREMENTS_RELEASE
	string "Git release of OpenStack Requirements"
	help
	  The Git commit/branch/tag of OpenStack Requirements
	  to use from the repo specified at OPENSTACK_REQUIREMENTS_GIT_URL
	default "master"
```

## buildroot-ipa/configs/openstack_ipa_defconfig
```kconfig
BR2_x86_64=y
BR2_DL_DIR="$(BR2_EXTERNAL_IPA_PATH)/../dl"
BR2_CCACHE=y
BR2_CCACHE_DIR="$(BR2_EXTERNAL_IPA_PATH)/../ccache"
BR2_TOOLCHAIN_BUILDROOT_GLIBC=y
BR2_KERNEL_HEADERS_4_8=y
BR2_BINUTILS_VERSION_2_27_X=y
BR2_GCC_VERSION_6_X=y
BR2_TOOLCHAIN_BUILDROOT_CXX=y
BR2_TARGET_GENERIC_HOSTNAME="ipa"
BR2_TARGET_GENERIC_ISSUE="Welcome to OpenStack IPA"
BR2_TARGET_GENERIC_PASSWD_SHA256=y
BR2_INIT_SYSTEMD=y
BR2_ROOTFS_DEVICE_TABLE_SUPPORTS_EXTENDED_ATTRIBUTES=y
# BR2_TARGET_ENABLE_ROOT_LOGIN is not set
BR2_SYSTEM_BIN_SH_BASH=y
BR2_TARGET_GENERIC_GETTY_PORT="tty1"
BR2_ROOTFS_OVERLAY="$(BR2_EXTERNAL_IPA_PATH)/board/openstack/ipa/rootfs-overlay $(BR2_EXTERNAL_IPA_PATH)/../overlay"
BR2_ROOTFS_POST_BUILD_SCRIPT="$(BR2_EXTERNAL_IPA_PATH)/board/openstack/ipa/post-build.sh $(BR2_EXTERNAL_IPA_PATH)/../scripts/post-build.sh"
BR2_ROOTFS_POST_FAKEROOT_SCRIPT="$(BR2_EXTERNAL_IPA_PATH)/board/openstack/ipa/post-fakeroot.sh $(BR2_EXTERNAL_IPA_PATH)/../scripts/post-fakeroot.sh"
BR2_ROOTFS_POST_IMAGE_SCRIPT="$(BR2_EXTERNAL_IPA_PATH)/board/openstack/ipa/post-image.sh $(BR2_EXTERNAL_IPA_PATH)/../scripts/post-image.sh"
BR2_ROOTFS_POST_SCRIPT_ARGS="'$(OPENSTACK_IPA_GIT_URL)' '$(OPENSTACK_IPA_RELEASE)' '$(OPENSTACK_REQUIREMENTS_GIT_URL)' '$(OPENSTACK_REQUIREMENTS_RELEASE)'"
BR2_LINUX_KERNEL=y
BR2_LINUX_KERNEL_CUSTOM_VERSION=y
BR2_LINUX_KERNEL_CUSTOM_VERSION_VALUE="4.10.6"
BR2_LINUX_KERNEL_USE_CUSTOM_CONFIG=y
BR2_LINUX_KERNEL_CUSTOM_CONFIG_FILE="$(BR2_EXTERNAL_IPA_PATH)/board/openstack/ipa/linux-$(BR2_LINUX_KERNEL_CUSTOM_VERSION_VALUE).config"
BR2_LINUX_KERNEL_XZ=y
BR2_PACKAGE_BUSYBOX_CONFIG="$(BR2_EXTERNAL_IPA_PATH)/board/openstack/ipa/busybox.config"
BR2_PACKAGE_XZ=y
BR2_PACKAGE_E2FSPROGS=y
BR2_PACKAGE_E2FSPROGS_RESIZE2FS=y
BR2_PACKAGE_LINUX_FIRMWARE=y
BR2_PACKAGE_DMIDECODE=y
BR2_PACKAGE_GPTFDISK=y
BR2_PACKAGE_GPTFDISK_SGDISK=y
BR2_PACKAGE_IPMITOOL=y
BR2_PACKAGE_PARTED=y
BR2_PACKAGE_PYTHON=y
BR2_PACKAGE_PYTHON_PY_ONLY=y
BR2_PACKAGE_PYTHON_BZIP2=y
BR2_PACKAGE_PYTHON_READLINE=y
BR2_PACKAGE_PYTHON_SSL=y
BR2_PACKAGE_PYTHON_UCS4=y
BR2_PACKAGE_PYTHON_PYEXPAT=y
BR2_PACKAGE_PYTHON_HASHLIB=y
BR2_PACKAGE_PYTHON_SHUTILWHICH=y
BR2_PACKAGE_PYTHON_URLLIB3=y
BR2_PACKAGE_LIBISCSI=y
BR2_PACKAGE_ELFUTILS=y
BR2_PACKAGE_QEMU=y
BR2_PACKAGE_QEMU_TOOLS=y
BR2_PACKAGE_IPTABLES=y
BR2_PACKAGE_OPENSSH=y
BR2_PACKAGE_WGET=y
BR2_PACKAGE_COREUTILS=y
BR2_PACKAGE_IRQBALANCE=y
BR2_PACKAGE_PROCPS_NG=y
BR2_PACKAGE_PSMISC=y
# BR2_PACKAGE_SYSTEMD_HOSTNAMED is not set
# BR2_PACKAGE_SYSTEMD_HWDB is not set
BR2_PACKAGE_SYSTEMD_LOGIND=y
# BR2_PACKAGE_SYSTEMD_MYHOSTNAME is not set
BR2_PACKAGE_SYSTEMD_RANDOMSEED=y
# BR2_PACKAGE_SYSTEMD_TIMEDATED is not set
# BR2_PACKAGE_SYSTEMD_TIMESYNCD is not set
# BR2_PACKAGE_SYSTEMD_TMPFILES is not set
BR2_TARGET_ROOTFS_CPIO_XZ=y
BR2_TARGET_ROOTFS_ISO9660=y
BR2_TARGET_ROOTFS_ISO9660_HYBRID=y
# BR2_TARGET_ROOTFS_TAR is not set
BR2_TARGET_SYSLINUX=y
BR2_PACKAGE_HOST_GPTFDISK=y
```
